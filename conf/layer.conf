## conf/layer.conf
```bitbake
# We have a conf and classes directory, add to BBPATH
BBPATH .= ":${LAYERDIR}"

# We have recipes-* directories, add to BBFILES
BBFILES += "${LAYERDIR}/recipes-*/*/*.bb \
            ${LAYERDIR}/recipes-*/*/*.bbappend"

BBFILE_COLLECTIONS += "meta-coverity"
BBFILE_PATTERN_meta-coverity = "^${LAYERDIR}/"
BBFILE_PRIORITY_meta-coverity = "6"

LAYERDEPENDS_meta-coverity = "core"
LAYERSERIES_COMPAT_meta-coverity = "kirkstone langdale"
```
